## CMakeLists.txt
```
# SPDX-License-Identifier: Apache-2.0

cmake_minimum_required(VERSION 3.20.0)

set(BOARD hs_c071rb)
set(BOARD_ROOT ${CMAKE_CURRENT_LIST_DIR}/../)

find_package(Zephyr REQUIRED HINTS $ENV{ZEPHYR_BASE})
project(blinky_pwm)


target_sources(app PRIVATE src/main.c)
```

## prj.conf
```kconfig
CONFIG_STDOUT_CONSOLE=y
CONFIG_PRINTK=y

CONFIG_PWM=y
CONFIG_PWM_STM32=y

CONFIG_LOG=y
CONFIG_LOG_PRINTK=y
CONFIG_LOG_MODE_IMMEDIATE=y
CONFIG_PWM_LOG_LEVEL_DBG=y

CONFIG_GPIO=y
# enable pin controller
CONFIG_PINCTRL=y
```

## src/main.c
```c
/*
 * Copyright (c) 2016 Intel Corporation
 * Copyright (c) 2020 Nordic Semiconductor ASA
 *
 * SPDX-License-Identifier: Apache-2.0
 */

/**
 * @file Sample app to demonstrate PWM-based LED fade
 */

#include <zephyr/kernel.h>
#include <zephyr/sys/printk.h>
#include <zephyr/device.h>
#include <zephyr/drivers/pwm.h>
#include <zephyr/drivers/gpio.h>

#define NUM_STEPS	5U


int main(void)
{
	uint32_t pulse_width_ns;
	uint32_t step_ns;
	uint8_t dir;
	uint32_t period_ns;
	int ret;
	const struct pwm_dt_spec pwm_led = PWM_DT_SPEC_GET(DT_NODELABEL(green_pwm_led));
	uint32_t *puint32;
	const struct gpio_dt_spec brake_pin = GPIO_DT_SPEC_GET(DT_ALIAS(motor_a_brake), gpios);
	const struct gpio_dt_spec dir_pin = GPIO_DT_SPEC_GET(DT_ALIAS(motor_a_dir), gpios);
	uint32_t brake_state = 0;
	uint32_t dir_state = 0;


	printk("PWM-based LED fade for %s, channel=%u\n", pwm_led.dev->name, pwm_led.channel);
	
	
	if (!gpio_is_ready_dt(&brake_pin)) {
		printk("Brake pin not ready\n");
		return 0;
	}
	if (!gpio_is_ready_dt(&dir_pin)) {
		printk("Dir pin not ready\n");
		return 0;
	}
	
	ret = gpio_pin_configure_dt(&brake_pin, GPIO_OUTPUT_ACTIVE);
	if (ret < 0) {
		printk("Brake pin not configured\n");
		return 0;
	}
	ret = gpio_pin_configure_dt(&dir_pin, GPIO_OUTPUT_ACTIVE);
	if (ret < 0) {
		printk("Dir pin not configured\n");
		return 0;
	}
	
	ret = gpio_pin_set_dt(&brake_pin, brake_state);
	if (ret < 0) {
		printk("Brake pin not set\n");
		return ret;
	}
	ret = gpio_pin_set_dt(&dir_pin, dir_state);
	if (ret < 0) {
		printk("Dir pin not set\n");
		return ret;
	}

	
	period_ns = PWM_USEC(40); //pwm_led.period;
	pulse_width_ns = 3*period_ns/4;
	step_ns = period_ns / NUM_STEPS;
	dir = 1U;
	if (!pwm_is_ready_dt(&pwm_led)) {
		printk("Error: PWM device %s is not ready\n", pwm_led.dev->name);
		return 0;
	}
	printk("PWM: period_ns=%uns=%ums, step_ns=%uns=%ums, \n", period_ns, period_ns/1000/1000, step_ns, step_ns/1000/1000);
	
	// MOE must be enabled!
	puint32 = (uint32_t*) 0x40012c44;
	*puint32 |= 1<<15;

	
	
	while (1) {
		k_sleep(K_MSEC(500));
		
		if (true) {
			if (brake_state == 0) {
				if (dir_state == 1) {
					dir_state = 0;
				}
				else {
					brake_state = 1;
				}
			}
			else {
				if (dir_state == 0) {
					dir_state = 1;
				}
				else {
					brake_state = 0;
				}
			}
		}
		else {
			if (dir_state == 0) {
				dir_state = 1;
			}
			else {
				dir_state = 0;
			}
		}
		ret = gpio_pin_set_dt(&brake_pin, brake_state);
		if (ret < 0) {
			printk("Brake pin not toggled\n");
			return ret;
		}
		ret = gpio_pin_set_dt(&dir_pin, dir_state);
		if (ret < 0) {
			printk("Dir pin not toggled\n");
			return ret;
		}

		ret = pwm_set_dt(&pwm_led, period_ns, pulse_width_ns);
		if (ret) {
			printk("Error %d: failed to set pulse width for LED\n", ret);
		}

		printk("LED: Using pulse width %d%% (%ums), brake = %u, dir = %u\n",
				100 * pulse_width_ns / period_ns, pulse_width_ns/1000/1000, brake_state, dir_state);

		// if (dir == 1) {
		// 	if (pulse_width_ns + step_ns >= period_ns) {
		// 		pulse_width_ns = period_ns;
		// 		dir = 0U;
		// 	} else {
		// 		pulse_width_ns += step_ns;
		// 	}
		// } else {
		// 	if (pulse_width_ns <= step_ns) {
		// 		pulse_width_ns = 0;
		// 		dir = 1U;
		// 	} else {
		// 		pulse_width_ns -= step_ns;
		// 	}
		// }

	}
	return 0;
}
```
