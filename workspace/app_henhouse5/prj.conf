## CMakeLists.txt
```
# SPDX-License-Identifier: Apache-2.0

cmake_minimum_required(VERSION 3.20.0)


# set(BOARD hs5_c071rb)
set(BOARD hs5_wl55jc)
set(BOARD_ROOT ${CMAKE_CURRENT_LIST_DIR}/../)

find_package(Zephyr REQUIRED HINTS $ENV{ZEPHYR_BASE})
project(henhouse5)


include(FetchContent)
FetchContent_Declare(
    ecpp_static_vector
    GIT_REPOSITORY https://github.com/jmacheta/static_vector.git
    GIT_TAG main
    )
FetchContent_MakeAvailable(ecpp_static_vector)
# target_link_libraries(app PUBLIC ecpp_static_vector)
include_directories(${CMAKE_CURRENT_BINARY_DIR}/_deps/ecpp_static_vector-src/include)

include_directories(${CMAKE_CURRENT_LIST_DIR}/includes)

target_sources(app PRIVATE
    src/errorcode.cpp
    src/thread.cpp
    src/outputpin.cpp
    src/inputpin.cpp
    src/statusleds.cpp
    src/pwm.cpp
    src/doorstate.cpp
    src/doorcontrol.cpp
    src/motor.cpp
    src/rtc.cpp
    src/doortriggerauto.cpp
    src/doorcontrolthread.cpp
    src/main.cpp
    )
```

## prj.conf
```kconfig
CONFIG_CPP=y
CONFIG_STD_CPP20=y
CONFIG_REQUIRES_FULL_LIBCPP=y
CONFIG_MAIN_STACK_SIZE=8192

CONFIG_STDOUT_CONSOLE=y

CONFIG_SHELL=y
# CONFIG_SHELL_MINIMAL=y
CONFIG_KERNEL_SHELL=y
CONFIG_INIT_STACKS=y
CONFIG_THREAD_STACK_INFO=y
CONFIG_THREAD_NAME=y
CONFIG_THREAD_MONITOR=y
CONFIG_THREAD_RUNTIME_STATS=y
CONFIG_THREAD_RUNTIME_STATS_USE_TIMING_FUNCTIONS=y

CONFIG_LOG=y
CONFIG_SHELL_LOG_BACKEND=y
CONFIG_LOG_PRINTK=y
CONFIG_LOG_MODE_IMMEDIATE=y
# CONFIG_LOG_MODE_DEFERRED=y
# CONFIG_LOG_RUNTIME_FILTERING=y
# CONFIG_LOG_BUFFER_SIZE=2048
# CONFIG_LOG_PROCESS_TRIGGER_THRESHOLD=0
# CONFIG_COVERAGE=n
# CONFIG_LOG_TAG_MAX_LEN=8

CONFIG_GPIO=y
CONFIG_PINCTRL=y

CONFIG_PWM=y
CONFIG_PWM_STM32=y

CONFIG_RTC=y
CONFIG_RTC_ALARM=y
```

## src/main.cpp
```c
#include <zephyr/logging/log.h>
#include "errorcode.h"
#include "inputpin.h"
#include "outputpin.h"
#include "statusleds.h"
#include "motor.h"
#include "doorstate.h"
#include "doorcontrol.h"
#include "rtc.hpp"
#include "doorcontrolthread.h"
#include "doortriggerauto.h"

LOG_MODULE_REGISTER(main, LOG_LEVEL_INF);



///////////////////////////////////////////////////////////////////////////////
// Threads
///////////////////////////////////////////////////////////////////////////////
K_THREAD_STACK_DEFINE(stack_doorState, 4096);
const int32_t prio_doorState = K_PRIO_COOP(1); // higher number = lower prio

K_THREAD_STACK_DEFINE(stack_statusLeds, 1024);
const int32_t prio_statusLeds = K_PRIO_COOP(10); // higher number = lower prio

K_THREAD_STACK_DEFINE(stack_doorTriggerAuto, 1024);
const int32_t prio_doorTriggerAuto = K_PRIO_COOP(2); // higher number = lower prio

K_THREAD_STACK_DEFINE(stack_doorControlThread, 1024);
const int32_t prio_doorControlThread = K_PRIO_COOP(3); // higher number = lower prio

int main(void)
{
    ErrorCode ec;
    k_sleep(K_SECONDS(1)); // awaiting shell thread to start such that logs are shown
    LOG_INF("Hello to Henhouse5!");
    
    OutputPin ledGreen(ErrorCode::Instance::ledGreen, GPIO_DT_SPEC_GET(DT_NODELABEL(green_led_2), gpios));
    ledGreen.init(false, false);
    //OutputPin led_blue(ErrorCode::Instance::led_blue, GPIO_DT_SPEC_GET(DT_NODELABEL(blue_led_1), gpios)); // blue is communication
    // led_blue.init(false, true);
    OutputPin ledRed(ErrorCode::Instance::ledRed, GPIO_DT_SPEC_GET(DT_NODELABEL(red_led_3), gpios));
    ledRed.init(false, true);
    StatusLeds statusLeds(ErrorCode::Instance::statusLeds, ledGreen, ledRed, stack_statusLeds, K_THREAD_STACK_SIZEOF(stack_statusLeds), prio_statusLeds);
    statusLeds.start();

    // inputs
    Rtc rtc(ErrorCode::Instance::rtc);
    DoorTriggerAuto doorTriggerAuto(ErrorCode::Instance::doorTriggerAuto, rtc, stack_doorTriggerAuto, K_THREAD_STACK_SIZEOF(stack_doorTriggerAuto), prio_doorTriggerAuto);
    rtc.registerCallback([&doorTriggerAuto](uint16_t alarmId) -> void {return doorTriggerAuto.alarmCallback(alarmId);});
    rtc.init();
	rtc.set_date_time(50,29,8,4,5,2020);
    
    InputPin buttonOpen(ErrorCode::Instance::buttonOpen, GPIO_DT_SPEC_GET(DT_ALIAS(button_open), gpios), GPIO_INT_EDGE_FALLING);
    InputPin buttonClose(ErrorCode::Instance::buttonClose, GPIO_DT_SPEC_GET(DT_ALIAS(button_close), gpios), GPIO_INT_EDGE_FALLING);
    InputPin endswitchBottom(ErrorCode::Instance::endswitchBottom, GPIO_DT_SPEC_GET(DT_NODELABEL(endswitchbottom), gpios), GPIO_INT_EDGE_BOTH);
    InputPin endswitchTop(ErrorCode::Instance::endswitchTop, GPIO_DT_SPEC_GET(DT_NODELABEL(endswitchtop), gpios), GPIO_INT_EDGE_BOTH);
    Pwm pwm(ErrorCode::Instance::motorPwm, PWM_DT_SPEC_GET(DT_NODELABEL(green_pwm_led)));
    OutputPin brakePin(ErrorCode::Instance::motorBrakePin, GPIO_DT_SPEC_GET(DT_ALIAS(motor_a_brake), gpios));
    OutputPin dirPin(ErrorCode::Instance::motorDirPin, GPIO_DT_SPEC_GET(DT_ALIAS(motor_a_dir), gpios));
    DoorState doorState(ErrorCode::Instance::doorState, endswitchBottom, endswitchTop, stack_doorState, K_THREAD_STACK_SIZEOF(stack_doorState), prio_doorState);
    Motor motor = Motor(ErrorCode::Instance::motor, pwm, brakePin, dirPin);
    DoorControl doorControl(ErrorCode::Instance::doorControl, motor, doorState);
    DoorControlThread doorControlThread(ErrorCode::Instance::doorControlThread, doorControl, stack_doorControlThread, K_THREAD_STACK_SIZEOF(stack_doorControlThread), prio_doorControlThread);

    endswitchBottom.registerCallback([&doorState](uint32_t pinInstanceId) -> void {return doorState.endswitchChanged(pinInstanceId);});
    endswitchTop.registerCallback([&doorState](uint32_t pinInstanceId) -> void {return doorState.endswitchChanged(pinInstanceId);});
    buttonOpen.registerCallback([&doorControlThread](uint32_t pinInstanceId) -> void {doorControlThread.openClose(true, DoorCommanderEnum::MANUAL);});
    buttonClose.registerCallback([&doorControlThread](uint32_t pinInstanceId) -> void {doorControlThread.openClose(false, DoorCommanderEnum::MANUAL);});
    doorState.registerCallback([&doorControl](DoorStateEnum state) -> void {return doorControl.doorstateChanged(state);});
    
    endswitchBottom.init();
    endswitchTop.init();
    buttonOpen.init();
    buttonClose.init();
    
    doorControl.init();
    doorState.start();
    doorControlThread.start();
    
    doorTriggerAuto.registerCallback([&doorControlThread](bool doOpen) -> void {doorControlThread.openClose(doOpen, DoorCommanderEnum::AUTO);});
    doorTriggerAuto.start();

    // actors
    motor.init();

    while (true) {
        k_sleep(K_HOURS(1));
    }

	return 0;
}
    
```

## src/button.cpp
```c
#include "button.h"


static void button_pressed(const struct device *dev, struct gpio_callback *cb,
		    uint32_t pins)
{
    // why so complicated to get button class? Ask Zephyr devs... Details in description of callback_container struct.
    const struct callback_container* cb_container = CONTAINER_OF(cb, struct callback_container, callback_data);
    const Button* button = cb_container->button;
	printk("This: %p Button %p / %u pressed at %" PRIu32 "\n", button, dev, pins, k_cycle_get_32());
};

Button::Button(ErrorCode::Instance instance, const struct gpio_dt_spec pin) :
    m_instance(instance),
    m_pin(pin),
    m_value(0)
    {
        m_cb_container.button = this;
}

const ErrorCode Button::init() {
    int ret;
	if (!gpio_is_ready_dt(&m_pin)) {
		printk("Error: m_pin device %s is not ready\n",
		       m_pin.port->name);
		return ErrorCode(m_instance, ErrorCode::not_ready, 1);
	}

	ret = gpio_pin_configure_dt(&m_pin, GPIO_INPUT);
	if (ret != 0) {
		printk("Error %d: failed to configure %s pin %d\n",
		       ret, m_pin.port->name, m_pin.pin);
        return ErrorCode(m_instance, ErrorCode::invalid_config, 1);
	}

	ret = gpio_pin_interrupt_configure_dt(&m_pin,
					      GPIO_INT_EDGE_TO_ACTIVE);
	if (ret != 0) {
		printk("Error %d: failed to configure interrupt on %s pin %d\n",
			ret, m_pin.port->name, m_pin.pin);
        return ErrorCode(m_instance, ErrorCode::invalid_config, 2);
	}


	gpio_init_callback(&m_cb_container.callback_data, button_pressed, BIT(m_pin.pin));
	gpio_add_callback(m_pin.port, &m_cb_container.callback_data);
	printk("Set up m_pin at %s pin %d\n", m_pin.port->name, m_pin.pin);

    return ErrorCode(m_instance, ErrorCode::success);
}

const bool Button::get() {
    m_value = gpio_pin_get(m_pin.port, m_pin.pin);
    return m_value;
}
```

## src/door.cpp
```c
#include "door.h"

#include <zephyr/logging/log.h>
LOG_MODULE_REGISTER(Door, LOG_LEVEL_INF);

Door::Door(ErrorCode::Instance instance, Motor& motor, InputPin& endswitch_top, InputPin& endswitch_bottom) :
m_instance(instance),
m_motor(motor),
m_endswitch_top(endswitch_top),
m_endswitch_bottom(endswitch_bottom) {
    
    }

const ErrorCode Door::init() {
    return ErrorCode(m_instance, ErrorCode::success);
}
const ErrorCode Door::openClose(bool do_open) {
    InputPin* startPos = nullptr;
    InputPin* endPos = nullptr;
    ErrorCode::Code errorcode_door_start_wrong;
    ErrorCode::Code errorcode_door_end_wrong;
    float speed;
    ErrorCode ec;

    if (do_open) {
        LOG_INF("Opening door...");
        startPos = &m_endswitch_top;
        endPos = &m_endswitch_bottom;
        errorcode_door_start_wrong = ErrorCode::Code::door_start_opening_wrong;
        errorcode_door_end_wrong = ErrorCode::Code::door_end_opening_wrong;
        speed = +1.0f;
    }
    else {
        LOG_INF("Closing door...");
        startPos = &m_endswitch_bottom;
        endPos = &m_endswitch_top;
        errorcode_door_start_wrong = ErrorCode::Code::door_start_closing_wrong;
        errorcode_door_end_wrong = ErrorCode::Code::door_end_closing_wrong;
        speed = -1.0f;
    }
    
    if (!startPos->get()) {
        LOG_INF("Start position wrong!");
        // not returning, we want to continue no matter the init state!
        ErrorCode(m_instance, errorcode_door_start_wrong, 1);
    }
    
    // now moving the motors...
    m_motor.setSpeed(speed);
    
    // awaiting end switch with timeout
    LOG_INF("awaiting end switch with timeout");
    ec = endPos->await(K_SECONDS(10));
    // Not returning yet, we want to stop motors first...
    if (ec.m_code == ErrorCode::Code::timeout) {
        LOG_WRN("Awaiting end position timed out!");
    }
    m_motor.setSpeed(0.0f);
    
    return ec; // we are mainly interested if the target was reached within time        
}
```

## src/doorcontrol.cpp
```c
#include "doorcontrol.h"

#include <zephyr/logging/log.h>
LOG_MODULE_REGISTER(DoorControl, LOG_LEVEL_INF);

DoorControl::DoorControl(ErrorCode::Instance instance, Motor& motor, DoorState &doorState) :
    m_instance(instance),
    m_motor(motor),
    m_doorState(doorState),
    m_target_doorstate(static_cast<uint32_t>(DoorStateEnum::UNINITIALIZED)) {
    
    }

const ErrorCode DoorControl::init() {
    k_sem_init(&m_semaphore_target_doorstate_reached, 0, 1);
    return ErrorCode(m_instance, ErrorCode::success);
}
const ErrorCode DoorControl::openClose(bool do_open) {
    DoorStateEnum expected_start_state;
    DoorStateEnum expected_end_state;
    ErrorCode::Code errorcode_door_start_wrong;
    ErrorCode::Code errorcode_door_end_wrong;
    int8_t speed_percent = +100;
    ErrorCode ec;

    if (do_open) {
        LOG_INF("Opening door...");
        speed_percent *= +1;
        errorcode_door_start_wrong = ErrorCode::Code::door_start_opening_wrong;
        errorcode_door_end_wrong = ErrorCode::Code::door_end_opening_wrong;
        expected_start_state = DoorStateEnum::CLOSED;
        expected_end_state = DoorStateEnum::OPEN;        
        atomic_set(&m_target_doorstate, static_cast<uint32_t>(DoorStateEnum::OPEN));
    }
    else {
        LOG_INF("Closing door...");
        speed_percent *= -1;
        errorcode_door_start_wrong = ErrorCode::Code::door_start_closing_wrong;
        errorcode_door_end_wrong = ErrorCode::Code::door_end_closing_wrong;
        expected_start_state = DoorStateEnum::OPEN;
        expected_end_state = DoorStateEnum::CLOSED;        
        atomic_set(&m_target_doorstate, static_cast<uint32_t>(DoorStateEnum::CLOSED));
    }

    if (m_doorState.get() == expected_end_state) {
        LOG_INF("Already there, doing nothing");
        return ErrorCode(m_instance, ErrorCode::Code::success);
    }
    
    if (m_doorState.get() != expected_start_state) {
        LOG_WRN("Start state wrong!");
        // not returning, we want to continue no matter the init state!
        ErrorCode(m_instance, errorcode_door_start_wrong, 1);
    }
    
    // now moving the motors...
    m_motor.setSpeed(speed_percent);
    
    // awaiting end switch with timeout
    int ret = k_sem_take(&m_semaphore_target_doorstate_reached, K_SECONDS(30));
    m_motor.setSpeed(0.0f);

    if (ret != 0) {
        LOG_WRN("Awaiting doorstate to reach target timed out! (ret=%i)", ret);
        return ErrorCode(m_instance, ErrorCode::Code::timeout, 1);
    }

    // just checking again..
    if (m_doorState.get() != expected_end_state) {
        LOG_WRN("End state wrong! (ret=%i)", ret);
        return ErrorCode(m_instance, errorcode_door_end_wrong, 1);
    }
    LOG_INF("Target doorstate reached!");
    return ErrorCode(m_instance, ErrorCode::Code::success);
}



void DoorControl::doorstateChanged(DoorStateEnum state) {
    // thread context: DoorState!
    // therefore, atomic!
    DoorStateEnum state_to_forward = static_cast<DoorStateEnum>(atomic_get(&m_target_doorstate));
    if (state == state_to_forward) {
        k_sem_give(&m_semaphore_target_doorstate_reached);
    }
    else {
        LOG_DBG("Not interested in doorstate=%u", static_cast<uint32_t>(state));
    }
}
```

## src/doorcontrolthread.cpp
```c
#include "doorcontrolthread.h"
#include <zephyr/shell/shell.h>

#include <zephyr/logging/log.h>
LOG_MODULE_REGISTER(DoorControlThread, LOG_LEVEL_INF);

DoorControlThread* DoorControlThread::self = nullptr;

DoorControlThread::DoorControlThread(ErrorCode::Instance instance, DoorControl & doorControl, k_thread_stack_t * stack, const uint32_t stack_size, const uint32_t priority) :
    Thread(instance, stack, stack_size, priority, "DoorControlThread"),
    m_instance(instance),
    m_doorControl(doorControl),
    m_lastCommander(DoorCommanderEnum::UNDEFINED)
{    
    if (self != nullptr) {
        LOG_ERR("DoorControlThread can only exist once!");
    }
    self = this;
}

const ErrorCode DoorControlThread::run() {
	LOG_DBG("DoorControlThread started");
    k_msgq_init(&m_commandQueue, m_commandQueueBuffer, sizeof(bool), m_commandQueueMaxEntries);

    while(true) {
        bool do_open;
        k_msgq_get(&m_commandQueue, &do_open, K_FOREVER);
        m_doorControl.openClose(do_open);
    }

    return ErrorCode(Thread::m_instance, ErrorCode::Code::unexpected_exit, 1);
}

void DoorControlThread::openClose(bool do_open, DoorCommanderEnum commander) {
	LOG_INF("Received openclose (do_open=%u) command from %u", do_open, static_cast<uint32_t>(commander));
    k_msgq_put(&m_commandQueue, &do_open, K_NO_WAIT);
}



/////////////////////////////////////////////////////////////////////
// Shell commands
/////////////////////////////////////////////////////////////////////
static int shellCmd_openDoor(const struct shell *sh, size_t argc, char **argv)
{
	ARG_UNUSED(argc);
	ARG_UNUSED(argv);

	DoorControlThread::getInstance()->openClose(true, DoorCommanderEnum::SHELL);

	return 0;
}

static int shellCmd_closeDoor(const struct shell *sh, size_t argc, char **argv)
{
	ARG_UNUSED(argc);
	ARG_UNUSED(argv);

	DoorControlThread::getInstance()->openClose(false, DoorCommanderEnum::SHELL);

	return 0;
}

static int shellCmd_cycleOpenCloseDoor(const struct shell *sh, size_t argc, char **argv)
{
	ARG_UNUSED(argc);
	// int nCycles = std::stoi(argv[0]); // current leading to HARD FAULT
	int nCycles = 1;
    LOG_INF("Cycle door open/close %u times", nCycles);

    for (int i = 0; i < nCycles; i++) {
        DoorControlThread::getInstance()->openClose(true, DoorCommanderEnum::SHELL);
        k_sleep(K_SECONDS(1));
        DoorControlThread::getInstance()->openClose(false, DoorCommanderEnum::SHELL);
        k_sleep(K_SECONDS(1));
    }

	return 0;
}


/* Creating subcommands (level 1 command) array for command "demo". */
SHELL_STATIC_SUBCMD_SET_CREATE(sub_door,
        SHELL_CMD(open, NULL, "Open door", shellCmd_openDoor),
        SHELL_CMD(close, NULL, "Close door", shellCmd_closeDoor),
        SHELL_CMD(cycle, NULL, "Cycle openclose", shellCmd_cycleOpenCloseDoor),
        SHELL_SUBCMD_SET_END
);
/* Creating root (level 0) command "door" */
SHELL_CMD_REGISTER(door, &sub_door, "Door open/close", NULL);
```

## src/doorstate.cpp
```c
#include "doorstate.h"

#include <zephyr/logging/log.h>
LOG_MODULE_REGISTER(DoorState, LOG_LEVEL_INF);

DoorState::DoorState(const ErrorCode::Instance instance, InputPin& endswitchTop, InputPin& endswitchBottom, k_thread_stack_t * stack, const uint32_t stack_size, const uint32_t priority) :
    Thread(instance, stack, stack_size, priority, "DoorState"),
    Publisher(instance),
    m_state(DoorStateEnum::UNINITIALIZED),
    m_endswitch_top(endswitchTop),
    m_endswitch_bottom(endswitchBottom){
}


const ErrorCode DoorState::run() {
	LOG_INF("Doorstate started");
    update_state();
    k_msgq_init(&m_endswitches_queue, m_endswitches_queue_buffer, sizeof(ErrorCode::Instance), m_n_endswitches_queue_max_entries);

    while(true) {
        uint32_t pin_instance_id;
        k_msgq_get(&m_endswitches_queue, &pin_instance_id, K_FOREVER);
        update_state();
    }

    return ErrorCode(Thread::m_instance, ErrorCode::Code::success);
}

void DoorState::update_state() {
    bool state_top = m_endswitch_top.get();
    bool state_bottom = m_endswitch_bottom.get();

    DoorStateEnum prev_state = m_state;
    if (state_top && !state_bottom) {
        m_state = DoorStateEnum::OPEN;
        LOG_INF("Door is open");
    }
    else if(!state_top && state_bottom) {
        m_state = DoorStateEnum::CLOSED;
        LOG_INF("Door is closed");
    }
    else if(!state_top && !state_bottom) {
        if (prev_state == DoorStateEnum::CLOSED) {
            m_state = DoorStateEnum::OPENING;
            LOG_INF("Door is opening");
        }
        else if (prev_state == DoorStateEnum::OPEN) {
            m_state = DoorStateEnum::CLOSING;
            LOG_INF("Door is closing");
        }
        else {
            m_state = DoorStateEnum::UNDEFINED;
            LOG_INF("Door is in undefined state");            
        }
    }
    else {
        m_state = DoorStateEnum::INVALID;
        LOG_ERR("Door state is invalid - both endswitches are set!");
    }

    if (m_state != prev_state) {
        _notify(m_state);
    }
}

const DoorStateEnum DoorState::get() {
    return m_state;
}

void DoorState::endswitchChanged(uint32_t pin_instance_id) {
    k_msgq_put(&m_endswitches_queue, &pin_instance_id, K_NO_WAIT);
}
```

## src/doortriggerauto.cpp
```c
#include "doortriggerauto.h"

#include <zephyr/sys/timeutil.h>
#include <zephyr/logging/log.h>
LOG_MODULE_REGISTER(DoorTriggerAuto, LOG_LEVEL_INF);

DoorTriggerAuto::DoorTriggerAuto(ErrorCode::Instance instance, Rtc& rtc, k_thread_stack_t * stackArea, const uint32_t stackSize, const int32_t priority) :
    Thread(instance, stackArea, stackSize, priority, "DoorTriggerAuto"),
	Publisher(instance),
	m_rtc(rtc),
	m_nextDoOpen(false)
	{
	}


#if 0
// @todo move test function to integration test...
const ErrorCode DoorTriggerAuto::run() {
    k_sem_init(&m_alarm_semaphore, 0, 1);
	
    while(true) {
		autoOpenClose();
		int tm_sec, tm_min, tm_hour;
		m_rtc.get_time(tm_hour, tm_min, tm_sec);
		tm_sec += 10;
		m_rtc.set_alarm(tm_hour, tm_min, tm_sec);
		
		k_sem_take(&m_alarm_semaphore, K_FOREVER);
        m_rtc.log_date_time();
    }

	return ErrorCode(Thread::m_instance, ErrorCode::runtime, 255);
}
#endif


const ErrorCode DoorTriggerAuto::run() {
    k_sem_init(&m_alarmSemaphore, 0, 1);
	autoOpenClose();
    while(true) {
		updateAlarm();

		// wait around half a day...
		k_sem_take(&m_alarmSemaphore, K_FOREVER);
        m_rtc.log_date_time();
		doOpenClose(m_nextDoOpen);
    }

	return ErrorCode(Thread::m_instance, ErrorCode::unexpected_exit, 1);
}

const bool DoorTriggerAuto::shouldNowBeOpen() {
	int tm_sec, tm_min, tm_hour;
	m_rtc.get_time(tm_hour, tm_min, tm_sec);

	const int32_t timeNow   = tm_sec +           tm_min*60 +           tm_hour*3600;
	const int32_t timeOpen  =      0 +  m_openTimeMin*60 +  m_openTimeHour*3600;
	const int32_t timeClose =      0 + m_closeTimeMin*60 + m_closeTimeHour*3600;

	if (timeNow > timeClose || timeNow < timeOpen) {
		return false;
	}
	else {
		return true;
	}
}

const ErrorCode DoorTriggerAuto::updateAlarm() {
	int tm_sec, tm_min, tm_hour;
	bool next_close = shouldNowBeOpen();
	
	if (next_close) {
		tm_hour = m_closeTimeHour;
		tm_min = m_closeTimeMin;
		tm_sec = 0;
		LOG_INF("Next: close door at %02u:%02u!", tm_hour, tm_min);
	}
	else {
		tm_hour = m_openTimeHour;
		tm_min = m_openTimeMin;
		tm_sec = 0;
		LOG_INF("Next: open door at %02u:%02u!", tm_hour, tm_min);
	}
	m_nextDoOpen = !next_close;
	return m_rtc.set_alarm(tm_hour, tm_min, tm_sec);
}

const ErrorCode DoorTriggerAuto::doOpenClose(bool doOpen) {
	return _notify(doOpen);
}

const ErrorCode DoorTriggerAuto::autoOpenClose() {
	bool doOpenNow = shouldNowBeOpen();
	if (doOpenNow) {
		LOG_INF("Open door!");
	}
	else {
		LOG_INF("Close door!");
	}

	return doOpenClose(doOpenNow);
}


void DoorTriggerAuto::alarmCallback(uint16_t alarmId) {
    k_sem_give(&m_alarmSemaphore);
}
```

## src/errorcode.cpp
```c
#include "errorcode.h"

#include <zephyr/logging/log.h>
LOG_MODULE_REGISTER(ErrorCode, LOG_LEVEL_INF);

ErrorCode::ErrorCode(Instance instance, Code code, uint8_t number) :
    m_instance(instance),
    m_code(code),
    m_number(number)
{
    if (m_instance != Instance::INVALID && m_code != Code::success) {
        LOG_ERR("Instance=%u, Code=%u, Number=%u", m_instance, m_code, m_number);
    }
}

const uint32_t ErrorCode::serialize() {
    uint32_t serialized = 0;
    serialized += ((m_code && 0xFF) << 0);
    serialized += ((m_number && 0xFF) << 8);
    serialized += ((m_instance && 0xFF) << 24);
    return serialized;
}

bool ErrorCode::hasFailed() {
    return m_code != Code::success;
}
```

## src/inputpin.cpp
```c
#include "inputpin.h"
#include <functional>
#include <zephyr/logging/log.h>
LOG_MODULE_REGISTER(InputPin, LOG_LEVEL_WRN);


void inputpin_isr(const struct device *dev, struct gpio_callback *cb,
		    uint32_t pins)
{
    // why so complicated to get InputPin class? Ask Zephyr devs... Details in description of InputPin_PrivateCallbackContainer struct.
    struct InputPin_PrivateCallbackContainer* cb_container = CONTAINER_OF(cb, struct InputPin_PrivateCallbackContainer, callback_data);
	LOG_DBG("InputPin ISR instance %u", cb_container->m_instance);
	InputPin* this_ptr = cb_container->this_ptr;
	this_ptr->_notify(cb_container->m_instance);
};

InputPin::InputPin(ErrorCode::Instance instance, const struct gpio_dt_spec pin, const uint32_t gpio_event) :
	Publisher(instance),
    m_instance(instance),
    m_pin(pin),
	m_gpio_event(gpio_event)
    {
        m_cb_container.m_instance = m_instance;
		m_cb_container.this_ptr = this;
}

const ErrorCode InputPin::init() {
    int ret;

	if (!gpio_is_ready_dt(&m_pin)) {
		return ErrorCode(m_instance, ErrorCode::notReady, 1);
	}

	ret = gpio_pin_configure_dt(&m_pin, GPIO_INPUT);
	if (ret != 0) {
        return ErrorCode(m_instance, ErrorCode::invalid_config, 2);
	}

	ret = gpio_pin_interrupt_configure_dt(&m_pin, m_gpio_event);
	if (ret != 0) {
        return ErrorCode(m_instance, ErrorCode::invalid_config, 3);
	}


	gpio_init_callback(&m_cb_container.callback_data, inputpin_isr, BIT(m_pin.pin));

	ret = gpio_add_callback(m_pin.port, &m_cb_container.callback_data);
	if (ret != 0) {
		return ErrorCode(m_instance, ErrorCode::invalid_config, 4);
	}

    return ErrorCode(m_instance, ErrorCode::success);
}

const bool InputPin::get() {
    bool value = gpio_pin_get(m_pin.port, m_pin.pin);
    return value;
}
```

## src/motor.cpp
```c
#include "motor.h"
#include <zephyr/shell/shell.h>
#include <cmath>

#include <zephyr/logging/log.h>
LOG_MODULE_REGISTER(Motor, LOG_LEVEL_DBG);


Motor* Motor::self = nullptr;

Motor::Motor(const ErrorCode::Instance instance, Pwm &pwm, OutputPin &brake_pin, OutputPin &dir_pin) :
    m_instance(instance),
    m_pwm(pwm),
    m_brake_pin(brake_pin),
    m_dir_pin(dir_pin)
{
    if (self != nullptr) {
        LOG_ERR("Motor can only exist once!");
    }
    self = this;

}

const ErrorCode Motor::init() {
    ErrorCode ret = ErrorCode();
    
    ret = m_brake_pin.init(true, 1);
    if (ret.hasFailed()) {
        return ret;
    }
    ret = m_dir_pin.init(true, 0);
    if (ret.hasFailed()) {
        return ret;
    }
    
    ret = m_pwm.init();
    if (ret.hasFailed())
        return ret;

    ret = setSpeed(0.0);
    if (ret.hasFailed())
        return ret;

    return ErrorCode(m_instance, ErrorCode::Code::success);
}

const ErrorCode Motor::setSpeed(const int8_t percent) {
    ErrorCode ret;
    
    const int8_t duty_cycle = std::abs(percent);
    const int8_t min_duty_cycle = 10; // torque is low, even without load
    const bool brake_state = duty_cycle <= min_duty_cycle;    
    const bool dir_state = percent >= 0;
    
    
    ret = m_brake_pin.set(brake_state);
    if (ret.hasFailed()) {
        return ret;
    }
    ret = m_dir_pin.set(dir_state);
    if (ret.hasFailed()) {
        return ret;
    }
    ret = m_pwm.setDutyCycle(duty_cycle);
    if (ret.hasFailed()) {
        return ret;
    }
    
    if (brake_state) {
        LOG_INF("Motor stopped");
    }
    else {
        LOG_INF("PWM %u%%, brake = %u, dir = %u",
            duty_cycle, brake_state, dir_state);
    }

    return ErrorCode(m_instance, ErrorCode::Code::success);;
}

const ErrorCode Motor::testMotor() {
    const int8_t min_speed = -100;
    const int8_t max_speed = 100;
    const int8_t zero_speed = 0;
    const int8_t step = 10;
    int8_t speed = zero_speed;
    ErrorCode ec;
    
    for (; speed < max_speed; speed += step) {
        ec = setSpeed(speed);
        if (ec.hasFailed()) {
            return ec;
        }
        k_sleep(K_MSEC(200));
    }
    for (; speed > min_speed; speed -= step) {
        ec = setSpeed(speed);
        if (ec.hasFailed()) {
            return ec;
        }
        k_sleep(K_MSEC(200));
    }
    ec = setSpeed(0);
    if (ec.hasFailed()) {
        return ec;
    }


    return ErrorCode(m_instance, ErrorCode::Code::success);
}


/////////////////////////////////////////////////////////////////////
// Shell commands
/////////////////////////////////////////////////////////////////////
static int shellCmd_testMotor(const struct shell *sh, size_t argc, char **argv)
{
	ARG_UNUSED(argc);
	ARG_UNUSED(argv);

	Motor::getInstance()->testMotor();

	return 0;
}
static int shellCmd_stop(const struct shell *sh, size_t argc, char **argv)
{
	ARG_UNUSED(argc);
	ARG_UNUSED(argv);

	Motor::getInstance()->setSpeed(0);

	return 0;
}


/* Creating subcommands (level 1 command) array for command "demo". */
SHELL_STATIC_SUBCMD_SET_CREATE(sub_motor,
        SHELL_CMD(test, NULL, "Test (spin up and down in both directions)", shellCmd_testMotor),
        SHELL_CMD(stop, NULL, "Stop", shellCmd_stop),
        SHELL_SUBCMD_SET_END
);
/* Creating root (level 0) command "door" */
SHELL_CMD_REGISTER(motor, &sub_motor, "Motor", NULL);
```

## src/outputpin.cpp
```c
#include "outputpin.h"

OutputPin::OutputPin(ErrorCode::Instance instance, const struct gpio_dt_spec pin) :
    m_instance(instance),
    m_pin(pin),
    m_value(0)
    {
}

const ErrorCode OutputPin::init(const bool is_active, const bool initial_value) {
    int retint;
    ErrorCode retEC;
	if (!gpio_is_ready_dt(&m_pin)) {
		printk("Pin not ready\n");
		return ErrorCode(m_instance, ErrorCode::notReady, 1);
	}


	retint = gpio_pin_configure_dt(&m_pin, is_active ? GPIO_OUTPUT_ACTIVE : GPIO_OUTPUT_INACTIVE);
	if (retint < 0) {
        printk("Pin not configured\n");
        return ErrorCode(m_instance, ErrorCode::invalid_config, 1);
	}

    retEC = set(initial_value);
    if (retEC.hasFailed()) {
        return retEC;
    }

    return ErrorCode(m_instance, ErrorCode::success);
}

const ErrorCode OutputPin::set(const bool value) {
    int ret;
	ret = gpio_pin_set_dt(&m_pin, value ? 1 : 0);
	if (ret < 0) {
        printk("Pin not set\n");
        return ErrorCode(m_instance, ErrorCode::runtime, 1);
	}
    m_value = value;
    return ErrorCode(m_instance, ErrorCode::success);
}

const bool OutputPin::get() {
    return m_value;
}
```

## src/pwm.cpp
```c
#include "pwm.h"
#include <cmath>
#include <algorithm>


Pwm::Pwm(const ErrorCode::Instance instance, const struct pwm_dt_spec pwm) :
    m_instance(instance),
    m_pwm(pwm)
    {
}

const ErrorCode Pwm::init() {
    
	if (!pwm_is_ready_dt(&m_pwm)) {
        return ErrorCode(m_instance, ErrorCode::notReady, 1);
	}
	
    return ErrorCode(m_instance, ErrorCode::Code::success);
}

const ErrorCode Pwm::setDutyCycle(const uint8_t percent) {
    const uint8_t min_duty_cycle = 0;
    const uint8_t max_duty_cycle = 101; // add safety margin to allow later saturation without throwing too many errors due to rounding/floating point
    if (percent > max_duty_cycle || percent < min_duty_cycle) {
        return ErrorCode(m_instance, ErrorCode::Code::invalid_argument, 1);
    }

    uint32_t pulse_width = (static_cast<uint32_t>(percent) * m_period) /100;
    pulse_width = std::min(pulse_width, m_period); // saturate to maximum!

    int32_t ret = pwm_set_dt(&m_pwm, m_period, pulse_width);
    if (ret) {
        return ErrorCode(m_instance, ErrorCode::Code::runtime, 2);
    }

    return ErrorCode(m_instance, ErrorCode::Code::success);
}
```

## src/rtc.cpp
```c
#include "rtc.hpp"

#include <zephyr/logging/log.h>
LOG_MODULE_REGISTER(Rtc, LOG_LEVEL_INF);

#include <zephyr/kernel.h>
#include <zephyr/device.h>
#include <zephyr/drivers/rtc.h>
#include <zephyr/sys/util.h>

Rtc::Rtc(const ErrorCode::Instance instance) :
    Publisher(instance),
    m_rtc(DEVICE_DT_GET(DT_ALIAS(rtc)))
    {
    
}

const ErrorCode Rtc::init() {
    if (!device_is_ready(m_rtc)) {
        LOG_ERR("RTC is not ready\n");
		return ErrorCode(m_instance, ErrorCode::notReady, 1);
	}
    return ErrorCode(m_instance, ErrorCode::success);
}

static void alarm_callback(const struct device *dev, uint16_t id, void *this_ptr) {
    LOG_INF("Alarm id %u", id);
    Rtc* rtc = static_cast<Rtc*>(this_ptr);
    rtc->_notify(id);
}



const ErrorCode Rtc::set_date_time(int tm_sec, int tm_min, int tm_hour, int tm_mday, int tm_mon, int tm_year) {
	int ret = 0;
    struct rtc_time tm = {
            .tm_sec = tm_sec,
            .tm_min = tm_min,
            .tm_hour = tm_hour,
            .tm_mday = tm_mday,
            .tm_mon = tm_mon-1,
            .tm_year = tm_year-1900,
        };

	ret = rtc_set_time(m_rtc, &tm);
	if (ret < 0) {
        LOG_ERR("Cannot write date time: %d\n", ret);
		return ErrorCode(m_instance, ErrorCode::runtime, 1);
	}
	LOG_INF("RTC set: %04d-%02d-%02d %02d:%02d:%02d", tm.tm_year+1900,
	       tm.tm_mon+1, tm.tm_mday, tm.tm_hour, tm.tm_min, tm.tm_sec);
    return ErrorCode(m_instance, ErrorCode::success);
}


const ErrorCode Rtc::get_time(int& tm_hour, int& tm_min, int& tm_sec) {
	int ret = 0;
	struct rtc_time tm;

	ret = rtc_get_time(m_rtc, &tm);
	if (ret < 0) {
        LOG_ERR("Cannot read date time: %d\n", ret);
		return ErrorCode(m_instance, ErrorCode::runtime, 2);
	}

    tm_hour = tm.tm_hour;
    tm_min = tm.tm_min;
    tm_sec = tm.tm_sec;
    return ErrorCode(m_instance, ErrorCode::success);
}


const ErrorCode Rtc::log_date_time() {
	int ret = 0;
	struct rtc_time tm;

	ret = rtc_get_time(m_rtc, &tm);
	if (ret < 0) {
        LOG_ERR("Cannot read date time: %d\n", ret);
		return ErrorCode(m_instance, ErrorCode::runtime, 2);
	}

	LOG_INF("It is now: %04d-%02d-%02d %02d:%02d:%02d", tm.tm_year+1900,
	       tm.tm_mon+1, tm.tm_mday, tm.tm_hour, tm.tm_min, tm.tm_sec);

    return ErrorCode(m_instance, ErrorCode::success);
}


const ErrorCode Rtc::set_alarm(int tm_hour, int tm_min, int tm_sec) {
    int ret;

    // sanitize time!
    while (tm_sec >= 60) {
        tm_min += 1;
        tm_sec -= 60;
    }
    while (tm_min >= 60) {
        tm_hour += 1;
        tm_min -= 60;
    }
    while (tm_hour >= 24) {
        tm_hour -= 24;
    }


    LOG_INF("Setting alarm time to %02u:%02u:%02u!", tm_hour, tm_min, tm_sec);
    ret = rtc_alarm_set_callback(m_rtc, 0, alarm_callback, this);
    if (ret != 0) {
        LOG_ERR("Setting alarm callback failed: %i", ret);
        return ErrorCode(m_instance, ErrorCode::runtime, 1);
    }
    
    struct rtc_time alarm_time = {
        .tm_sec = tm_sec,
        .tm_min = tm_min,
        .tm_hour = tm_hour,
    };
    ret = rtc_alarm_set_time(m_rtc, 0, 
        RTC_ALARM_TIME_MASK_SECOND	| RTC_ALARM_TIME_MASK_MINUTE | RTC_ALARM_TIME_MASK_HOUR,
        &alarm_time);
    if (ret != 0) {
        LOG_ERR("Setting alarm time failed: %i", ret);
        return ErrorCode(m_instance, ErrorCode::runtime, 2);
    }
    
    return ErrorCode(m_instance, ErrorCode::success);
}
```
